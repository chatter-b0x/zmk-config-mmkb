## config/boards/arm/mmkb/Kconfig.board
```kconfig
#
# copyright (c) 2024 ZMK project contributors
# SPDX-license-identifier: MIT
#

# microcontroller for board
config BOARD_MMKB
    bool "mmkb"
    depends on SOC_NRF52840_QIAA
```

## config/boards/arm/mmkb/Kconfig.defconfig
```kconfig
#
# Copyright (c) 2024 ZMK Project Contributors
# SPDX-License-Identifier: MIT
#

if BOARD_MMKB


config ZMK_KEYBOARD_NAME
    default "MMKB"

config BT_CTLR
    default BT

config I2C
    default y

config ZMK_MAX17048
    default y


if USB

config USB_NRFX
    default y

config USB_DEVICE_STACK
    default y

endif # USB


if ZMK_DISPLAY

config SSD1306
    default y

config LV_Z_VDB_SIZE
    default 64

config LV_DPI_DEF
    default 148

config LV_Z_BITS_PER_PIXEL
    default 1

choice LV_COLOR_DEPTH
    default LV_COLOR_DEPTH_1
endchoice

endif # ZMK_DISPLAY


endif # BOARD_MMKB
```

## config/boards/arm/mmkb/mmkb_defconfig
```kconfig
#
# copyright (c) 2024 ZMK project contributors
# SPDX-license-identifier: MIT
#

# identify MCU and board
CONFIG_SOC_SERIES_NRF52X=y
CONFIG_SOC_NRF52840_QIAA=y
CONFIG_BOARD_MMKB=y

# system setup
CONFIG_ARM_MPU=y
CONFIG_MPU_ALLOW_FLASH_WRITE=y
CONFIG_NVS=y
CONFIG_SETTINGS_NVS=y
CONFIG_FLASH=y
CONFIG_FLASH_PAGE_LAYOUT=y
CONFIG_FLASH_MAP=y
CONFIG_USE_DT_CODE_PARTITION=y
CONFIG_BUILD_OUTPUT_UF2=y

# GPIO
CONFIG_GPIO=y
CONFIG_PINCTRL=y

# encoder
CONFIG_EC11=y
CONFIG_EC11_TRIGGER_GLOBAL_THREAD=y

# display
CONFIG_ZMK_DISPLAY=y
CONFIG_ZMK_WIDGET_BATTERY_STATUS_SHOW_PERCENTAGE=y
CONFIG_ZMK_WIDGET_OUTPUT_STATUS=y
CONFIG_I2C=y
CONFIG_I2C_NRFX=y

# RGB undeglow
CONFIG_ZMK_RGB_UNDERGLOW=y
CONFIG_ZMK_RGB_UNDERGLOW_EXT_POWER=y
CONFIG_ZMK_RGB_UNDERGLOW_ON_START=y
CONFIG_ZMK_RGB_UNDERGLOW_EFF_START=3
CONFIG_ZMK_RGB_UNDERGLOW_BRT_START=50
CONFIG_ZMK_RGB_UNDERGLOW_BRT_MAX=100
CONFIG_WS2812_STRIP=y
CONFIG_SPI=y

# USB & BLE
CONFIG_ZMK_USB=y
CONFIG_ZMK_BLE=y

# battery reporting
CONFIG_BT_GATT_ENFORCE_SUBSCRIPTION=y
CONFIG_ZMK_BATTERY_REPORTING=y

# # uncomment to enable deep sleep
# CONFIG_ZMK_SLEEP=y
# CONFIG_ZMK_IDLE_SLEEP_TIMEOUT=3600000

# # uncomment to enable USB logging / debugging
# CONFIG_ZMK_USB_LOGGING=y
# CONFIG_ZMK_LOG_LEVEL_DBG=y
# CONFIG_I2C_LOG_LEVEL_DBG=y
```

## config/west.yml
```yaml
manifest:
  remotes:
    - name: zmkfirmware
      url-base: https://github.com/zmkfirmware
    # additional modules containing boards/shields/custom code can be listed here as well
    # see https://docs.zephyrproject.org/3.2.0/develop/west/manifest.html#projects
  projects:
    - name: zmk
      remote: zmkfirmware
      revision: main
      import: app/west.yml
  self:
    path: config
```
